## br2external_nms/configs/nms_defconfig
```kconfig
BR2_mipsel=y
BR2_mips_p5600=y
# BR2_MIPS_SOFT_FLOAT is not set
BR2_SVN="svn"
BR2_KERNEL_MIRROR="https://www.kernel.org/pub"
BR2_GNU_MIRROR="http://ftp.gnu.org/pub/gnu"
BR2_CCACHE=y
BR2_OPTIMIZE_2=y
# BR2_PIC_PIE is not set
BR2_RELRO_NONE=y
BR2_FORTIFY_SOURCE_NONE=y
BR2_TOOLCHAIN_BUILDROOT_GLIBC=y
BR2_KERNEL_HEADERS_5_4=y
BR2_PACKAGE_GLIBC_KERNEL_COMPAT=y
BR2_TOOLCHAIN_BUILDROOT_CXX=y
BR2_TOOLCHAIN_GLIBC_GCONV_LIBS_COPY=y
BR2_TOOLCHAIN_GLIBC_GCONV_LIBS_LIST="CP1251 KOI8-R UNICODE UTF-16 UTF-32 UTF-7"
BR2_ROOTFS_SKELETON_CUSTOM=y
BR2_ROOTFS_SKELETON_CUSTOM_PATH="$(BR2_EXTERNAL_nms_PATH)/skeleton"
BR2_INIT_NONE=y
BR2_ROOTFS_DEVICE_CREATION_DYNAMIC_EUDEV=y
BR2_ROOTFS_DEVICE_TABLE=""
BR2_ROOTFS_OVERLAY="$(BR2_EXTERNAL_nms_PATH)/overlay"
BR2_ROOTFS_POST_BUILD_SCRIPT="$(BR2_EXTERNAL_nms_PATH)/board/nms-baikal-t1-uq7/remove.sh"
BR2_PACKAGE_BUSYBOX_CONFIG="$(BR2_EXTERNAL_nms_PATH)/configs/busybox.config"
BR2_PACKAGE_DOSFSTOOLS=y
BR2_PACKAGE_DOSFSTOOLS_FATLABEL=y
BR2_PACKAGE_DOSFSTOOLS_FSCK_FAT=y
BR2_PACKAGE_DOSFSTOOLS_MKFS_FAT=y
BR2_PACKAGE_E2FSPROGS=y
BR2_PACKAGE_E2FSPROGS_RESIZE2FS=y
BR2_PACKAGE_MTD=y
# BR2_PACKAGE_MTD_MTD_DEBUG is not set
# BR2_PACKAGE_MTD_NANDTEST is not set
# BR2_PACKAGE_MTD_MTDINFO is not set
# BR2_PACKAGE_MTD_UBICRC32 is not set
# BR2_PACKAGE_MTD_UBIHEALTHD is not set
# BR2_PACKAGE_EUDEV_ENABLE_HWDB is not set
BR2_PACKAGE_LIBUBOOTENV=y
BR2_PACKAGE_PICOCOM=y
BR2_PACKAGE_OPENSSL=y
BR2_PACKAGE_LIBOPENSSL_BIN=y
BR2_PACKAGE_LIBEVENT=y
BR2_PACKAGE_DROPBEAR=y
BR2_PACKAGE_DROPBEAR_DISABLE_REVERSEDNS=y
# BR2_PACKAGE_DROPBEAR_SMALL is not set
BR2_PACKAGE_IPERF3=y
BR2_PACKAGE_IPROUTE2=y
BR2_PACKAGE_LRZSZ=y
BR2_PACKAGE_SWUPDATE=y
BR2_PACKAGE_SWUPDATE_CONFIG="$(BR2_EXTERNAL_nms_PATH)/configs/swupdate.config"
BR2_TARGET_ROOTFS_CPIO=y
BR2_TARGET_ROOTFS_CPIO_GZIP=y
BR2_TARGET_ROOTFS_CPIO_UIMAGE=y
# BR2_TARGET_ROOTFS_TAR is not set
BR2_PACKAGE_HOST_E2FSPROGS=y
BR2_PACKAGE_HOST_GENPART=y
BR2_PACKAGE_HOST_MTOOLS=y
```

## multi.its
```
/dts-v1/;
/ {
description = "Baikal-T1 BFK3 boot ROM image";
#address-cells = <1>;
images {
 kernel@1 {
  description = "Linux Kernel 5.4.105-bfk3+";
  data = /incbin/("vmlinux.bin.gz");
  type = "kernel";
  arch = "mips";
  os = "linux";
  compression = "gzip";
  load = <0x80100000>;
  entry = <0x80c1d960>;
  hash@1 {
   algo = "crc32";
  };
 };
 initrd@1 {
  description = "Minimal Root Filesystem";
  data = /incbin/("buildroot-2022.02.7/output/images/rootfs.cpio.gz");
  type = "ramdisk";
  arch = "mips";
  os = "linux";
  compression = "gzip";
  hash@1 {
   algo = "crc32";
  };
 };
 fdt@1 {
  description = "Flatten Device Tree";
  data = /incbin/("src/kernel/arch/mips/boot/dts/baikal/baikal_t1_pico_itx.dtb");
  type = "flat_dt";
  arch = "mips";
  compression = "none";
  hash@1 {
   algo = "crc32";
  };
 };
};
configurations {
 default = "conf@1";
 conf@1 {
  description = "Single boot image: kernel + device tree + minimal rootfs";
  kernel = "kernel@1";
  fdt = "fdt@1";
  ramdisk = "initrd@1";
  signature@1 {
   algo = "sha1,rsa2048";
   key-name-hint = "baikal";
  };
 };
};
};
```

## u-boot_defconfig
```kconfig
CONFIG_MIPS=y
CONFIG_SYS_MALLOC_F_LEN=0x800
CONFIG_NR_DRAM_BANKS=1
CONFIG_ENV_SIZE=0x00010000
CONFIG_ENV_OFFSET=0x000C0000
CONFIG_ENV_SECT_SIZE=0x00010000
CONFIG_DM_GPIO=y
CONFIG_DEBUG_UART_BASE=0xBF04A000
CONFIG_DEBUG_UART_CLOCK=7350000
CONFIG_IDENT_STRING=" bfk3"
CONFIG_TARGET_BAIKAL_MIPS=y
CONFIG_BOARD_BFK3=y
CONFIG_BAIKAL_ECC=y
CONFIG_DEFAULT_DEVICE_TREE="baikal_bfk3"
CONFIG_MIPS_CACHE_INDEX_BASE=0x0
# CONFIG_MIPS_BOOT_CMDLINE_LEGACY is not set
# CONFIG_MIPS_BOOT_ENV_LEGACY is not set
CONFIG_MIPS_BOOT_FDT=y
CONFIG_DEBUG_UART=y
CONFIG_AHCI=y
CONFIG_FIT=y
CONFIG_OF_BOARD_SETUP=y
CONFIG_BOOTDELAY=3
CONFIG_DEFAULT_FDT_FILE="baikal_bfk3.dtb"
CONFIG_CONSOLE_MUX=y
CONFIG_BOARD_EARLY_INIT_R=y
CONFIG_BOARD_LATE_INIT=y
CONFIG_HUSH_PARSER=y
CONFIG_SYS_PROMPT="BAIKAL # "
CONFIG_CMD_CPU=y
CONFIG_CMD_BOOTMENU=y
CONFIG_CMD_ENV_CALLBACK=y
CONFIG_CMD_ENV_FLAGS=y
CONFIG_CMD_LZMADEC=y
CONFIG_CMD_CLK=y
CONFIG_CMD_DM=y
CONFIG_CMD_I2C=y
CONFIG_CMD_MTD=y
CONFIG_CMD_PART=y
CONFIG_CMD_USB=y
CONFIG_CMD_DHCP=y
CONFIG_CMD_PING=y
CONFIG_CMD_EXT2=y
CONFIG_CMD_EXT4=y
CONFIG_CMD_FAT=y
CONFIG_CMD_FS_GENERIC=y
CONFIG_CMD_MTDPARTS=y
CONFIG_CMD_UBI=y
CONFIG_EFI_PARTITION=y
CONFIG_OF_CONTROL=y
CONFIG_ENV_IS_IN_SPI_FLASH=y
CONFIG_ENV_ADDR=0x9C0C0000
CONFIG_USE_DEFAULT_ENV_FILE=y
CONFIG_DEFAULT_ENV_FILE="board/baikal/bfk3/env.txt"
CONFIG_DM=y
CONFIG_DWC_AHCI=y
CONFIG_BLK=y
CONFIG_CLK=y
CONFIG_CLK_BAIKAL=y
CONFIG_CPU=y
CONFIG_CPU_BAIKAL=y
CONFIG_DWAPB_GPIO=y
CONFIG_DWMAC_GPIO=y
CONFIG_DM_I2C=y
CONFIG_SYS_I2C_DW=y
CONFIG_DM_KEYBOARD=y
CONFIG_MISC=y
CONFIG_I2C_EEPROM=y
CONFIG_MTD=y
CONFIG_DM_MTD=y
CONFIG_MTD_SPI_NAND=y
CONFIG_DM_SPI_FLASH=y
CONFIG_SF_DEFAULT_BUS=2
CONFIG_SF_DEFAULT_SPEED=25000000
CONFIG_SPI_FLASH_STMICRO=y
CONFIG_SPI_FLASH_WINBOND=y
# CONFIG_SPI_FLASH_USE_4K_SECTORS is not set
CONFIG_SPI_FLASH_MTD=y
CONFIG_PHY_MICREL=y
CONFIG_DM_ETH=y
CONFIG_ETH_DESIGNWARE=y
CONFIG_NOP_PHY=y
CONFIG_SCSI=y
CONFIG_DM_SCSI=y
CONFIG_SPECIFY_CONSOLE_INDEX=y
CONFIG_DM_SERIAL=y
CONFIG_SERIAL_RX_BUFFER=y
CONFIG_DEBUG_UART_SHIFT=2
CONFIG_SYS_NS16550=y
CONFIG_SPI=y
CONFIG_DM_SPI=y
CONFIG_DESIGNWARE_SPI=y
CONFIG_USB=y
CONFIG_DM_USB=y
CONFIG_USB_XHCI_HCD=y
CONFIG_USB_XHCI_DWC3=y
CONFIG_USB_DWC3=y
CONFIG_USB_STORAGE=y
CONFIG_USB_KEYBOARD=y
CONFIG_DESIGNWARE_WATCHDOG=y
CONFIG_WDT=y
CONFIG_LZ4=y
```
